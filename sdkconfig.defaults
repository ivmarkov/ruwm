## sdkconfig.defaults
```kconfig
# The low-latency executor runs off from the main thread
CONFIG_ESP_MAIN_TASK_STACK_SIZE=20000

# Necessary, as we process Rust code on the system event loop, and sometimes run out of stack
CONFIG_ESP_SYSTEM_EVENT_TASK_STACK_SIZE=4096

# Necessary, as we process Rust code on the system event loop, and sometimes run out of stack
CONFIG_ESP_SYSTEM_EVENT_TASK_STACK_SIZE=4096

# For async-io
CONFIG_PTHREAD_TASK_STACK_SIZE_DEFAULT=4096

# Go figure...
CONFIG_FREERTOS_IDLE_TASK_STACKSIZE=4096

# This is 10 by default. 16 is the maximum
CONFIG_LWIP_MAX_SOCKETS=16
```

## sdkconfig.defaults.esp32
```kconfig
# FSM ULP is doing the water meter edge counting, even when the main CPU is sleeping
CONFIG_ESP32_ULP_COPROC_ENABLED=y
CONFIG_ESP32_ULP_COPROC_RESERVE_MEM=2048
# Same but for the master branch
CONFIG_ULP_COPROC_ENABLED=y
CONFIG_ULP_COPROC_TYPE=ULP_COPROC_TYPE_FSM
CONFIG_ULP_COPROC_RESERVE_MEM=2048
```
